## conf/distro/daily-driver.conf
```bitbake
# SPDX-License-Identifier: MIT
# SPDX-FileCopyrightText: 2025 Bartosz Golaszewski <bartosz.golaszewski@linaro.org>

require conf/distro/poky.conf

INIT_MANAGER = "systemd"

DISTRO_FEATURES:append = " \
    pam \
    polkit \
    security \
"

LICENSE_FLAGS_ACCEPTED = " \
    commercial \
"

PREFERRED_PROVIDER_virtual/base-utils = "coreutils"
```

## conf/layer.conf
```bitbake
# SPDX-License-Identifier: MIT
# SPDX-FileCopyrightText: 2025 Bartosz Golaszewski <bartosz.golaszewski@linaro.org>

BBPATH .= ":${LAYERDIR}"

BBFILES += " \
    ${LAYERDIR}/recipes-*/*.bb \
    ${LAYERDIR}/recipes-*/*.bbappend \
    ${LAYERDIR}/recipes-*/*/*.bb \
    ${LAYERDIR}/recipes-*/*/*.bbappend \
"

BBFILE_COLLECTIONS += "daily-driver"
BBFILE_PATTERN_daily-driver := "^${LAYERDIR}/"
BBFILE_PRIORITY_daily-driver = "7"

LAYERDEPENDS_daily-driver = " \
    core \
    yocto \
    yoctobsp \
    openembedded-layer \
    networking-layer \
    meta-python \
    multimedia-layer \
    gnome-layer \
    filesystems-layer \
    meta-linux-mainline \
    qcom \
    qt6-layer \
    kde \
    kf6 \
    clang-layer \
    chromium-browser-layer \
    security \
"

LAYERSERIES_COMPAT_daily-driver = "styhead walnascar"
```

## conf/machine/thinkpad-x13s.conf
```bitbake
# SPDX-License-Identifier: MIT
# SPDX-FileCopyrightText: 2025 Bartosz Golaszewski <bartosz.golaszewski@linaro.org>

require conf/machine/genericarm64.conf
require conf/machine/include/qcom-common.inc

WKS_FILE = "thinkpad-x13s.wks.in"
KERNEL_DEVICETREE = "qcom/sc8280xp-lenovo-thinkpad-x13s.dtb"
IMAGE_EFI_BOOT_FILES += "sc8280xp-lenovo-thinkpad-x13s.dtb"
IMAGE_FSTYPES += "wic.bmap wic.bz2 ext4"

# We need a more recent kernel for better support than what styhead offers.
include conf/linux-mainline/stable.inc

PACKAGE_INSTALL:append = " \
    kernel-modules \
    ${@bb.utils.contains('DISTRO_FEATURES', 'opengl', 'mesa-driver-msm linux-firmware-qcom-adreno-a660', '', d)} \
    ${@bb.utils.contains('DISTRO_FEATURES', 'wifi', 'wireless-regdb-static linux-firmware-ath11k', '', d)} \
    ${@bb.utils.contains('DISTRO_FEATURES', 'bluetooth', 'linux-firmware-qca', '', d)} \
    linux-firmware-qcom-sc8280xp-lenovo-x13s-audio \
    linux-firmware-qcom-sc8280xp-lenovo-x13s-compute \
    linux-firmware-qcom-sc8280xp-lenovo-x13s-sensors \
    linux-firmware-qcom-sc8280xp-lenovo-x13s-adreno \
"

# Daily-driver specific variables
DD_DEVICETREE = "${@os.path.basename(d.getVar('KERNEL_DEVICETREE'))}"
DD_INSTALL_DEVICE = "/dev/sda"
DD_TARGET_DEVICE = "/dev/nvme0n1"
```
